## boards/shields/charybdis/Kconfig.defconfig
```kconfig
if SHIELD_CHARYBDIS_DONGLE

# Name must be less than 16 characters long!
config ZMK_KEYBOARD_NAME
    default "zmk_charybdis"

config ZMK_SPLIT_ROLE_CENTRAL
    default y

endif

if SHIELD_CHARYBDIS_LEFT || SHIELD_CHARYBDIS_RIGHT || SHIELD_CHARYBDIS_DONGLE

config ZMK_SPLIT
    default y

endif
```

## boards/shields/charybdis/Kconfig.shield
```kconfig
# No whitespace after the comma or in your part name!
config SHIELD_CHARYBDIS_LEFT
    def_bool $(shields_list_contains,charybdis_left)

# No whitespace after the comma or in your part name!
config SHIELD_CHARYBDIS_RIGHT
    def_bool $(shields_list_contains,charybdis_right)
```
